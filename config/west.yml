## config/west.yml
```yaml
manifest:
  remotes:
    - name: zmkfirmware
      url-base: https://github.com/zmkfirmware
    - name: isilmerie
      url-base: https://github.com/isilmerie
  projects:
    - name: zmk
      remote: isilmerie
      revision: main
      import: app/west.yml
  self:
    path: config
```
